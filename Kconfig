## Kconfig
```kconfig
menu "ESP Dashboard Plus"

config DASHBOARD_REQUIRE_WEBSOCKET
    bool
    default y
    select HTTPD_WS_SUPPORT

config DASHBOARD_ENABLE_OTA
    bool "Compile OTA update support"
    default y
    help
        Compile firmware-update message handling and the ESP-IDF application
        update dependency.  Disable this when the product does not provide OTA.

config DASHBOARD_ENABLE_CONSOLE
    bool "Compile console command and log support"
    default y
    help
        Compile inbound console commands and outbound console log messages.
        Disable this when the product does not expose a browser console.

config DASHBOARD_USE_HTTP
    bool "Use plain HTTP/WS instead of HTTPS/WSS"
    default n
    help
        When enabled the dashboard is served over plain HTTP and WebSocket
        (no TLS).  Useful during development to avoid self-signed certificate
        issues in browsers.
        WARNING: Traffic is unencrypted.  Do not use in production.

config DASHBOARD_MAX_STR_LEN
    int "Max string field length (chars)"
    default 64
    range 16 256
    help
        Maximum length for card string fields: id, title, value, unit, etc.
        Larger values increase RAM per card slot.

config DASHBOARD_MAX_CLIENTS
    int "Max simultaneous WebSocket clients"
    default 4
    range 1 8
    help
        Maximum number of browser tabs / WebSocket connections served simultaneously.

config DASHBOARD_MAX_WS_FRAME_LEN
    int "Max inbound WebSocket text frame length (bytes)"
    default 4096
    range 256 65536
    help
        Reject inbound WebSocket text frames larger than this limit before
        allocating a receive buffer.  Size this for the largest accepted
        dashboard action, console command, or OTA chunk message.

config DASHBOARD_PORT
    int "Listen port"
    default 80 if DASHBOARD_USE_HTTP
    default 443
    range 1 65535
    help
        TCP port the dashboard server listens on.
        Defaults to 80 (HTTP) or 443 (HTTPS).

config DASHBOARD_MAX_DROPDOWN_OPTS
    int "Max options per dropdown card"
    default 8
    range 2 32

endmenu
```
